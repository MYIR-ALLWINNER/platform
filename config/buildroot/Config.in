## config/buildroot/Config.in
```kconfig
menu "allwinner platform private package select"

config BR2_AW_GSTREAMER1
	bool "allwinner gstreamer1 package"
	help
	 select whether to use the allwinner private
	 gstreamer1 package

if BR2_AW_GSTREAMER1
config BR2_AW_GST_LIBAV
	bool "allwinner gstreamer libav package"
    default y
	help
	 select whether to use the allwinner private
	 gstreamer libav package

config BR2_AW_GST_OMX
	bool "allwinner gstreamer omx package"
    default y
	help
	 select whether to use the allwinner private
	 gstreamer libomx package

config BR2_AW_GST_BASE
	bool "allwinner gstreamer base package"
    default y
	help
	 select whether to use the allwinner private
	 gstreamer base package

config BR2_AW_GST_BAD
	bool "allwinner gstreamer bad package"
    default y
	help
	 select whether to use the allwinner private
	 gstreamer bad package

config BR2_AW_GST_GOOD
	bool "allwinner gstreamer good package"
    default y
	help
	 select whether to use the allwinner private
	 gstreamer good package

config BR2_AW_GST_UGLY
	bool "allwinner gstreamer ugly package"
    default y
	help
	 select whether to use the allwinner private
	 gstreamer ugly package
endif

config BR2_AW_WAYLAND
	bool "allwinner wayland package"
	default n
	help
	 select whether to use the allwinner private
	 wayland package

config BR2_AW_WAYLAND_IVI_EXTENSION
	bool "allwinner wayland-ivi-extension package"
	default n
	help
	 select whether to use the allwinner private
	 wayland-ivi-extension package

config BR2_AW_WAYLAND_PROTOCOLS
	bool "allwinner wayland-protocols package"
	default n
	help
	 select whether to use the allwinner private
	 wayland-protocols package

config BR2_AW_WESTON
	bool "allwinner weston package"
	default n
	help
	 select whether to use the allwinner private
	 weston package

config BR2_AW_MESA3D
	bool "allwinner mesa3d package"
	default n
	help
	 select whether to use the allwinner private
	 mesd3d package

source "../../platform/config/buildroot/demo/Config.in"
source "../../platform/config/buildroot/mtop/Config.in"
source "../../platform/config/buildroot/longan_info/Config.in"

source "../../platform/config/buildroot/libcedarc/Config.in"
source "../../platform/config/buildroot/cedarx/Config.in"
source "../../platform/config/buildroot/boot-play/Config.in"
source "../../platform/config/buildroot/mediaplayer/Config.in"

menu "nativepower"
source "../../platform/config/buildroot/nativepower/Config.in"
endmenu

menu "ota"
source "../../platform/config/buildroot/ota/Config.in"
endmenu

source "../../platform/config/buildroot/libawresample/Config.in"
source "../../platform/config/buildroot/libspeex-lite/Config.in"
source "../../platform/config/buildroot/resample/Config.in"
source "../../platform/config/buildroot/libcutils/Config.in"
source "../../platform/config/buildroot/libsys_info/Config.in"

source "../../platform/config/buildroot/mtp/Config.in"
source "../../platform/config/buildroot/logwrapper/Config.in"

menu "wifimanager"
source "../../platform/config/buildroot/wifi-manager/Config.in"
endmenu

#menu "smartlinkd"
source "../../platform/config/buildroot/smartlinkd/Config.in"
#endmenu

source "../../platform/config/buildroot/bluetooth/Config.in"

endmenu
```

## config/buildroot/bluetooth/Config.in
```kconfig
config BR2_PACKAGE_BLUETOOTH
	bool "bluetooth support"
	select BR2_PACKAGE_BLUEZ5_UTILS
	help
	  bluetooth .

if BR2_PACKAGE_BLUETOOTH

config BR2_PACKAGE_BLUETOOTH_REALTEK_RTL8723DS
	bool "realtek rtl8723ds"

config BR2_PACKAGE_BLUETOOTH_AMPAK
	bool "ampak"

endif
```

## config/buildroot/boot-play/Config.in
```kconfig
config BR2_PACKAGE_BOOT_PLAY
	bool "boot-play package"
	select BR2_PACKAGE_LIBUBOX
	help
	  boot-play package
```

## config/buildroot/cedarx/Config.in
```kconfig
config BR2_PACKAGE_CEDARX
	bool "cedarx"
	select BR2_PACKAGE_OPENSSL
	select BR2_PACKAGE_ZLIB
	help
	  cedarx
```

## config/buildroot/libcutils/Config.in
```kconfig
config BR2_PACKAGE_LIBCUTILS
	bool "libcutils"
	help
		Libcutils provides a self-contained set of fundamental routines which are
		essential to basically any Unix utility or daemon application written in C. The
		library provides fundamental data structures such as lists, hash-maps, strings
		and parsing functions for JSON or the typical dot-file based configuration data.
```

## config/buildroot/logwrapper/Config.in
```kconfig
config BR2_PACKAGE_LOGWRAPPER
	bool "logwrapper"
	help
	  Use logwrapper to redirect the standard output of the application.
```

## config/buildroot/longan_info/Config.in
```kconfig
config BR2_PACKAGE_LONGAN_INFO
	bool "longan_info"
	select BR2_PACKAGE_LIBSYS_INFO
	help
	  longan info
```

## config/buildroot/mediaplayer/Config.in
```kconfig
config BR2_PACKAGE_MEDIAPLAYER
	bool "mediaplayer package"
	select BR2_PACKAGE_LIBCEDARC
	select BR2_PACKAGE_CEDARX
	select BR2_PACKAGE_LIBDRM
	select BR2_PACKAGE_WESTON
	select BR2_PACKAGE_WAYLAND_IVI_EXTENSION
	help
	  mediaplayer package
```

## config/buildroot/mtp/Config.in
```kconfig
config BR2_PACKAGE_MTP
	bool "mtp"
	help
	  mtp is media transfer protocol deamon.
```

## config/buildroot/nativepower/Config.in
```kconfig
# nativepower
source "../../platform/config/buildroot/nativepower/libsuspend/Config.in"
source "../../platform/config/buildroot/nativepower/libnativepower/Config.in"
source "../../platform/config/buildroot/nativepower/libscenemanager/Config.in"
source "../../platform/config/buildroot/nativepower/nativepower_daemon/Config.in"
source "../../platform/config/buildroot/nativepower/nativepower_utils/Config.in"
```

## config/buildroot/nativepower/libnativepower/Config.in
```kconfig
config BR2_PACKAGE_LIBNATIVEPOWER
	bool "libnativepower"
	depends on BR2_PACKAGE_DBUS
	help
	  Libnativepower provides a set of power operation functions.
```

## config/buildroot/nativepower/libscenemanager/Config.in
```kconfig
config BR2_PACKAGE_LIBSCENEMANAGER
	bool "libscenemanager"
	help
	  libscenemanager provides a set of scene manager functions.
```

## config/buildroot/nativepower/libsuspend/Config.in
```kconfig
config BR2_PACKAGE_LIBSUSPEND
	bool "libsuspend"
	help
	  libsuspend is a colletction of autosuspend operation functions.
```

## config/buildroot/nativepower/nativepower_daemon/Config.in
```kconfig
config BR2_PACKAGE_NATIVEPOWER_DAEMON
	bool "nativepower_daemon"
	select BR2_PACKAGE_LIBSUSPEND
	select BR2_PACKAGE_LIBSCENEMANAGER
	help
	  nativepower_daemon is a daemon of nativepower.

if BR2_PACKAGE_NATIVEPOWER_DAEMON

config BR2_NATIVEPOWER_USE_DBUS
	bool "use dbus"
	depends on BR2_PACKAGE_DBUS

endif
```

## config/buildroot/nativepower/nativepower_utils/Config.in
```kconfig
config BR2_PACKAGE_NATIVEPOWER_UTILS
	bool "nativepower_utils"
	select BR2_PACKAGE_LIBSUSPEND
	select BR2_PACKAGE_LIBNATIVEPOWER
	help
	  nativepower_utils is a demo app for no dbus.
```

## config/buildroot/ota/Config.in
```kconfig
# ota
source "../../platform/config/buildroot/ota/misc-upgrade/Config.in"
source "../../platform/config/buildroot/ota/ota-burnboot/Config.in"
source "../../platform/config/buildroot/ota/ota-upgrade/Config.in"
```

## config/buildroot/ota/ota-upgrade/Config.in
```kconfig
config BR2_PACKAGE_OTA_UPGRADE
	bool "ota-upgrade"
	help
	  ota upgrade partition.
```
