## config/buildroot/smartlinkd/Config.in
```kconfig
config BR2_PACKAGE_SMARTLINKD
	bool "smartlinkd"
	help
	  smartlinkd.

if BR2_PACKAGE_SMARTLINKD

config BR2_PACKAGE_LIBSMARTLINKD_CLIENT
	bool "libsmartlinkd_client"
	help
	  smartlinkd libclient.

config BR2_PACKAGE_SMARTLINKD_SERVER
	bool "smartlinkd server"
	select BR2_PACKAGE_LIBSMARTLINKD_CLIENT
	help
	  smartlinkd server.

config BR2_PACKAGE_SMARTLINKD_SOUNDWAVE
	bool "smartlinkd soundwave"
	select BR2_PACKAGE_LIBSMARTLINKD_CLIENT
	help
	  smartlinkd soundwave.

config BR2_PACKAGE_SMARTLINKD_XR819_SMARTCONFIG
	bool "xr819 smartconfig"
	select BR2_PACKAGE_LIBSMARTLINKD_CLIENT
	help
	  xr819 smartconfig.

endif
```

## config/buildroot/wifi-manager/Config.in
```kconfig
# wifi-manager
source "../../platform/config/buildroot/wifi-manager/libwifimg/Config.in"
source "../../platform/config/buildroot/wifi-manager/wifi-manager-demo/Config.in"
```

## config/buildroot/wifi-manager/libwifimg/Config.in
```kconfig
config BR2_PACKAGE_LIBWIFIMG
	bool "libwifimg"
	help
	  libwifimg use in wifi station mode.
```

## config/buildroot/wifi-manager/wifi-manager-demo/Config.in
```kconfig
#config BR2_PACKAGE_WIFI_MANAGER_DEMO
#	bool "wifi-manager-demo"
#        depends on BR2_PACKAGE_WIFI_MANAGER
#	help
#	  wifi manager demo.
#
#if BR2_PACKAGE_WIFI_MANAGER_DEMO
#
#config BR2_PACKAGE_WIFI_SCAN_RESULTS
#	bool "wifi scan results"
#	select BR2_PACKAGE_WPA_SUPPLICANT
#
#endif

config BR2_PACKAGE_WIFI_MANAGER_DEMO
	bool "wifi-manager-demo"
	select BR2_PACKAGE_LIBWIFIMG
	help
	  wifi manager demo.
```
